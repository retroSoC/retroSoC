## app/ports/linux/configs/retrosoc_hp_defconfig
```kconfig
BR2_riscv=y
BR2_RISCV_64=y
BR2_RISCV_ISA_RVM=y
BR2_RISCV_ISA_RVA=y
BR2_RISCV_ISA_RVF=y
BR2_RISCV_ISA_RVD=y
BR2_RISCV_ISA_RVC=y
BR2_RISCV_ABI_LP64D=y
BR2_TOOLCHAIN_BUILDROOT_MUSL=y
BR2_STATIC_LIBS=y
BR2_TARGET_GENERIC_HOSTNAME="retrosoc-hp"
BR2_TARGET_GENERIC_ISSUE="retroSoC HP Linux"
BR2_INIT_NONE=y
BR2_PACKAGE_BUSYBOX_CONFIG="$(BR2_EXTERNAL_RETROSOC_HP_PATH)/busybox/retrosoc_hp.config"
BR2_TARGET_ROOTFS_CPIO=y
```

## app/ports/linux/opensbi/retrosoc_hp/Kconfig
```kconfig
# SPDX-License-Identifier: BSD-2-Clause

config PLATFORM_RETROSOC_HP
	bool
	select FDT
	select FDT_IRQCHIP
	select FDT_IRQCHIP_PLIC
	select IPI_MSWI
	default y
```
